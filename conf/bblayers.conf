## conf/bblayers.conf
```bitbake
# POKY_BBLAYERS_CONF_VERSION is increased each time build/conf/bblayers.conf
# changes incompatibly
POKY_BBLAYERS_CONF_VERSION = "2"

BBPATH = "${TOPDIR}"
BBFILES ?= ""

BBLAYERS ?= " \
  /home/alpha/poky/meta \
  /home/alpha/poky/meta-poky \
  /home/alpha/poky/meta-yocto-bsp \
  /home/alpha/meta-CFW-menu \
  "
```
